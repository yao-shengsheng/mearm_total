/* ============================================================================
 *  机械臂考核 —— 任务三 · 按键板【精简版】
 *  文件：uno_keys_basic.ino        板子：Arduino Uno（第二块，专职读按键）
 *
 *  ==========================================================================
 *  【这块板子只干一件事】
 *      按下按键 → 通过 TX 给主控发一个字符，主控收到后驱动机械臂：
 *
 *          按键 1  →  '1'    循环夹取（A → B → C → A …）
 *          按键 2  →  '2'    录制 开始 / 结束（同一个键切换）
 *          按键 3  →  '3'    回放上一次录制的动作
 *          按键 4  →  '4'    平滑回到初始位置
 *
 *      本文件是**精简版**：没有串口打印、没有调试命令，上电就能干活，
 *      代码短、看得清，演示时用这一版最省心。
 *      需要"接线自检 / 实时电平监视"这些排查工具，请用另一个文件
 *      uno_keys_check.ino。
 *
 *  ==========================================================================
 *  【★ 接线改了：以前用 D6→D10，现在用硬件串口 RX / TX】
 *  --------------------------------------------------------------------------
 *    上一版：按键板用软串口，把字符从 D6 发给主控的 D10（只发不收）。
 *    这一版：D6 ~ D10 那几根线**全部去掉**，改成两块板 RX / TX 对接 + 共地：
 *
 *        按键板 TX (D1)  ──>  主控 RX (D0)     ← 必须接，按键指令走这根线
 *        按键板 RX (D0)  <──  主控 TX (D1)     ← 可选，见下面 ② 的警告
 *        按键板 GND      ───  主控 GND         ← 必须接，不接必乱码
 *
 *    所以本程序直接用 Serial（Uno 唯一的硬件串口，引脚就是 D0/D1）来发字符，
 *    不再需要 SoftwareSerial —— 少一个库、少一层软件时序，更稳、更省事。
 *
 *  ==========================================================================
 *  ⚠⚠ 两条必须知道的"副作用"（硬件串口的固有特点，不是程序 bug）⚠⚠
 *
 *    ① Uno 的 D0/D1 同时也是 USB 口，所以这条线上"三方共用"：
 *         · 你在电脑串口监视器里打的字 → 会**同时**发给主控。
 *           在按键板的监视器里敲 '1'，主控也会真的去循环夹取一次。
 *         · 主控的打印 → 也会出现在按键板的监视器里。
 *       结论：**正常演示时，两块板都插 USB 只是为了供电，
 *             只看主控那一路的串口监视器就好。**
 *
 *    ② 烧录前，把"主控 TX → 按键板 RX"这根线**拔掉**（或给主控断电）。
 *       因为主控的 TX 是个强输出，一直把按键板的 RX 顶在高电平，
 *       会和 USB 串口芯片抢同一条线 —— 结果就是**烧录失败 / 校验出错**。
 *       ★ 只留"按键板 TX → 主控 RX + 共地"这两根，功能完全正常，
 *         而且拔插最省事、烧录从来不出问题。所以推荐就用 2 根线。
 *
 *  ==========================================================================
 *  【三个最容易踩的坑】
 *    · 忘共地（GND-GND）—— 十有八九的"第一次联调失败"都是它，收到全是乱码。
 *    · 按键只接了一端 —— 必须"一端接 D2~D5、另一端接 GND"，
 *      程序里用了芯片内部上拉，**不用加电阻**。
 *    · 两块板都插电脑时选错 COM 口 —— 会把程序烧进另一块板。
 *      给两块板各贴张纸条写上 COM 号最省事。
 * ==========================================================================*/


/* ============================================================================
 *  【1】接线配置（要改就改这里）
 * --------------------------------------------------------------------------
 *  这块 Uno 是"专职按键板"，上面不叠拓展板、不接舵机、不接摇杆，
 *  所以 D2~D12 几乎全空着，随便挑。
 *
 *  ★ 唯独 D0 / D1 绝对不能再接按键：那是硬件串口，已经用来跟主控说话了。
 *  ★ D13 上有板载 LED，接按键也能用，但每按一次灯会闪一下，避开就好。
 * ==========================================================================*/
const int KEY_PIN_1 = 2;    // 按键 1 → D2  发 '1'
const int KEY_PIN_2 = 3;    // 按键 2 → D3  发 '2'
const int KEY_PIN_3 = 4;    // 按键 3 → D4  发 '3'
const int KEY_PIN_4 = 5;    // 按键 4 → D5  发 '4'

/* ★ 为什么写成数组？
 *   四个按键的逻辑一模一样，写成数组 + 一个 for 循环，
 *   以后想改引脚只要改一处，不会漏掉某一个。
 *   （对照 check 版那种一个键一个变量的写法，这里更紧凑。） */
const int  KEY_PIN[4]  = { 2, 3, 4, 5 };
const char KEY_CHAR[4] = { '1', '2', '3', '4' };


/* ============================================================================
 *  【2】参数
 * ==========================================================================*/
const long BAUD = 9600;
/*  ★ 9600 必须和主控那边 Serial.begin(9600) 写的一致，
 *    不一致收到的就是一堆乱码 —— 这是联调最常见的故障。 */



/* ============================================================================
 *  【3】按键状态（做"边沿触发"用）
 * ==========================================================================*/
int lastState[4] = { HIGH, HIGH, HIGH, HIGH };   // 上一次读到的电平，HIGH = 松开


/* ============================================================================
 *  setup() —— 开机只跑一次
 * ==========================================================================*/
void setup(){
  /* ---- 1. 四个按键引脚：内部上拉输入 ----
   * ★ 用 INPUT_PULLUP 而不是普通 INPUT，是为了省掉 4 个外部上拉电阻。
   *   芯片每个 IO 口内部都有一个可打开的上拉电阻（约 20~50kΩ），
   *   打开之后：不按键时引脚被拉到高电平（读到 1），
   *             一按键引脚被直接接到 GND（读到 0）。
   *   面包板上少 4 个电阻 4 根线，好搭很多，也不容易接错。 */
  for (int i = 0; i < 4; i++) {
    pinMode(KEY_PIN[i], INPUT_PULLUP);
  }

  /* ---- 2. 打开硬件串口 ----
   * ★ 这一路既通电脑 USB，也通主控（因为 D0/D1 被引出去了）。
   *   本程序**只发不读**，所以主控那边回显什么过来都没关系 ——
   *   不读就不会影响按键扫描，永远不会被干扰。 */
  Serial.begin(BAUD);
}


/* ============================================================================
 *  loop() —— 主循环
 * ==========================================================================*/
void loop(){
  /* 四个按键各扫一遍。
   * ★ 本循环里**没有任何 delay()**，一圈跑完只要几十微秒，
   *   所以按键响应永远是"一按就有"，绝不会漏按。 */
  for (int i = 0; i < 4; i++) {
    scanKey(i);
  }
}


/* ============================================================================
 *  【4】按键扫描与发送
 * ==========================================================================*/

/*  scanKey() —— 扫描第 i 个按键，检测到"刚按下"就发对应字符
 *
 *    【★ 边沿触发 vs 电平触发 —— 这个区别很重要】
 *      本函数用的是**边沿触发**，条件是：
 *          现在读到 LOW（按下） 且 上一次是 HIGH（松开）
 *      → 只在"从松开变成按下"的那一瞬间触发一次。
 *      如果改成电平触发（只要读到 LOW 就发），按住不放就会一直发：
 *      按住按键 1 会让机械臂不停地循环夹取，根本没法用。
 *
 *    【★ 为什么用数组下标 i，而不是把代码抄四遍？】
 *      四个按键逻辑完全一样，抄四遍的话以后改引脚要改四处，
 *      很容易漏一个。用下标访问 KEY_PIN[i] / lastState[i] 就只改一处。
 */
void scanKey(int i){
  int cur = digitalRead(KEY_PIN[i]);

  /* 两个条件都要满足：
   *   ① 现在读到 LOW   —— 按键被按下
   *   ② 上一次是 HIGH  —— 才说明是"刚按下"这个瞬间 */
  if (cur == LOW && lastState[i] == HIGH) {

    /* ★ 用 write() 而不是 print()：
     *   print('1') 会先做类型转换、还可能附加别的东西；
     *   write('1') 的语义是明确的"我就发这一个字节"。
     *   协议是"一个字节 = 一条指令"，用 write 最不容易出岔子。 */
    Serial.write(KEY_CHAR[i]);
  }

  /* ★ 一定要把本次电平存回去，下次比较用。
   *   漏了这一步，按键就只会触发一次，之后再也不响应。 */
  lastState[i] = cur;
}


/* ============================================================================
 *  【5】联调步骤（按这个顺序做，最省时间）
 * ----------------------------------------------------------------------------
 *  【第一步 · 按键板自己先测通】★ 注意：先不要接主控那两根线
 *    1) 烧录本程序（此时 D0/D1 上什么都没有，不会干扰烧录）
 *    2) 打开串口监视器（9600）—— 本版程序自己不打印，
 *       所以屏幕是空的，这是正常的。
 *       ★ 想确认"按键到底有没有被读到"，有两个办法：
 *          a. 换烧 uno_keys_check.ino，发 t 做引导式自检（最直观）
 *          b. 先接上主控再测：每按一次键，主控那边会打印
 *             +key: 1          ← 看到它，就说明按键板这一段是好的
 *    3) 只想快点跑通的话：直接跳到第二步。
 *
 *  【第二步 · 接两根线，插上主控】
 *    1) 接线：按键板 TX(D1) → 主控 RX(D0)；★ 两板 GND 相连
 *    2) 主控烧配套程序，打开**主控**的串口监视器（9600）
 *    3) 按按键板的键，主控那边应该出现：
 *          +key: 1
 *    4) 收到乱码 → 两边波特率不一致，或者没共地
 *    5) 完全没反应 → 先晃动一下那两根线（面包板接触不良是常事）；
 *       再不行换个空闲引脚重烧两边
 *
 *  【第三步 · 整体验收（对着任务要求逐条演一遍）】
 *    按键 1 按三次 → 依次夹 A、B、C，第四次又回到 A（循环成立）
 *    按键 2 按一下 → 主控打印 REC START；用摇杆动 >10 秒；再按一下
 *                 → 打印录了多少帧、多少秒，并确认"满足 >10s"
 *    按键 3 按一下 → 机械臂把刚才那段动作完整重演
 *    按键 4 按一下 → 平滑回到初始位置
 *    ★ 演示顺序建议就按 1 → 2 → 3 → 4，正好覆盖任务书的叙述顺序。
 * ==========================================================================*/
